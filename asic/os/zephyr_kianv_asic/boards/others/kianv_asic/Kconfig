## asic/os/zephyr_kianv_asic/boards/others/kianv_asic/Kconfig
```kconfig
# SPDX-License-Identifier: Apache-2.0
# Copyright (c) 2026 Hirosh Dabui <hirosh@dabui.de>

config BOARD_KIANV_ASIC
	bool
```

## asic/os/zephyr_kianv_asic/boards/others/kianv_asic/Kconfig.defconfig
```kconfig
# SPDX-License-Identifier: Apache-2.0
# Copyright (c) 2026 Hirosh Dabui <hirosh@dabui.de>

if BOARD_KIANV_ASIC

config BUILD_OUTPUT_BIN
	default y

endif # BOARD_KIANV_ASIC
```

## asic/os/zephyr_kianv_asic/boards/others/kianv_asic/Kconfig.kianv_asic
```kconfig
# SPDX-License-Identifier: Apache-2.0
# Copyright (c) 2026 Hirosh Dabui <hirosh@dabui.de>

config BOARD_KIANV_ASIC
	select SOC_KIANV_RV32IMA
	select SERIAL_HAS_DRIVER
	select SERIAL_SUPPORT_INTERRUPT
```

## asic/os/zephyr_kianv_asic/boards/others/kianv_asic/board.yml
```yaml
# SPDX-License-Identifier: Apache-2.0
# Copyright (c) 2026 Hirosh Dabui <hirosh@dabui.de>

board:
  name: kianv_asic
  full_name: KianV RV32IMA ASIC SoC
  vendor: others
  socs:
    - name: kianv_rv32ima
```

## asic/os/zephyr_kianv_asic/soc/kianv/kianv_rv32ima/Kconfig
```kconfig
# SPDX-License-Identifier: Apache-2.0
# Copyright (c) 2026 Hirosh Dabui <hirosh@dabui.de>

config SOC_KIANV_RV32IMA
	select HAS_POWEROFF
	select INCLUDE_RESET_VECTOR
	select RISCV
	select RISCV_PRIVILEGED
	select SERIAL_HAS_DRIVER
	select RISCV_SOC_HAS_GP_RELATIVE_ADDRESSING
```

## asic/os/zephyr_kianv_asic/soc/kianv/kianv_rv32ima/Kconfig.defconfig
```kconfig
# SPDX-License-Identifier: Apache-2.0
# Copyright (c) 2026 Hirosh Dabui <hirosh@dabui.de>

if SOC_KIANV_RV32IMA

config SYS_CLOCK_HW_CYCLES_PER_SEC
	default 30000000

config RISCV_SOC_INTERRUPT_INIT
	default n

config NUM_IRQS
	default 16

config PMP_SLOTS
	default 16

endif # SOC_KIANV_RV32IMA
```

## asic/os/zephyr_kianv_asic/soc/kianv/kianv_rv32ima/Kconfig.soc
```kconfig
# SPDX-License-Identifier: Apache-2.0
# Copyright (c) 2026 Hirosh Dabui <hirosh@dabui.de>

config SOC_KIANV_RV32IMA
	bool

config SOC
	default "kianv_rv32ima" if SOC_KIANV_RV32IMA
```
